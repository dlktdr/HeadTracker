## firmware/src/Kconfig
```kconfig
mainmenu "Zephyr Kernel Configuration"

source "Kconfig.zephyr"

rsource "Kconfig.ht"
```

## firmware/src/Kconfig.ht
```kconfig
config LOG_BACKEND_HTGUI
	bool "HeadTracker GUI backend"
	select LOG_OUTPUT
	help
	  Backend that sends log messages over the HeadTracker GUI interface

if LOG_BACKEND_HTGUI

backend = HTGUI
backend-str = htgui
source "subsys/logging/Kconfig.template.log_format_config"

endif # LOG_BACKEND_BLE
```

## firmware/src/dts/bindings/ppm_input.yaml
```yaml
description: GPIO pin to input the PPM signal

compatible: "ppm-input-gpio"

properties:
  gpios:
    type: phandle-array
    required: true
    description: |
      The GPIO to input a PPM signal.
```

## firmware/src/dts/bindings/ppm_output.yaml
```yaml
description: GPIO pin to output the PPM signal

compatible: "ppm-output-gpio"

properties:
  gpios:
    type: phandle-array
    required: true
    description: |
      The GPIO to output a PPM signal.
```

## firmware/src/zephyr/boards/arm/arduino_nano_33_ble/Kconfig.board
```kconfig
# Copyright (c) 2020 Jefferson Lee.
# SPDX-License-Identifier: Apache-2.0

config BOARD_ARDUINO_NANO_33_BLE
	bool "Arduino Nano 33 BLE board"
	depends on SOC_NRF52840_QIAA

config BOARD_ARDUINO_NANO_33_BLE_INIT
	bool "Initialize the board"
	depends on BOARD_ARDUINO_NANO_33_BLE
```

## firmware/src/zephyr/boards/arm/arduino_nano_33_ble/Kconfig.defconfig
```kconfig
# Copyright (c) 2020 Jefferson Lee.
# SPDX-License-Identifier: Apache-2.0

if BOARD_ARDUINO_NANO_33_BLE
config BOARD
	default "arduino_nano_33_ble"

config BT_CTLR
	default BT

config BOARD_ARDUINO_NANO_33_BLE_INIT
	default y

if I2C
config I2C_NRFX
	default y
config NRFX_TWIM
	default y
config I2C_0
	default y
config I2C_1
	default y
endif #I2C

if SPI
config SPI_NRFX
	default y
config NRFX_SPIM
	default y
config SPI_2_NRF_SPIM
	default y
endif #SPI

endif #board
```

## firmware/src/zephyr/boards/arm/dtqsys_ht/Kconfig.board
```kconfig
# Copyright (c) 2020 Jefferson Lee.
# SPDX-License-Identifier: Apache-2.0

config BOARD_DTQSYS_HT
	bool "Board DTQSys HT"
	depends on SOC_NRF52840_QIAA
	select I2C

# Keep for compatibility with arduino nano 33 ble.. for now
config BOARD_ARDUINO_NANO_33_BLE_EN_USB_CONSOLE
	bool "Sends the console output over the USB port"
	depends on BOARD_DTQSYS_HT

config BOARD_DTQSYS_INIT
	bool "Initializes the internal I2C sensors on the board"
	depends on BOARD_DTQSYS_HT
```

## firmware/src/zephyr/boards/arm/dtqsys_ht/Kconfig.defconfig
```kconfig
# Copyright (c) 2020 Jefferson Lee.
# SPDX-License-Identifier: Apache-2.0

if BOARD_DTQSYS_HT

config BT_CTLR
	default BT

config I2C
  default y

endif #board
```

## firmware/src/zephyr/boards/arm/dtqsys_ht/Kconfig.dtqsys_ht
```kconfig
# Copyright (c) 2020 Jefferson Lee.
# SPDX-License-Identifier: Apache-2.0

config BOARD_DTQSYS_HT
	select SOC_NRF52840_QIAA
```

## firmware/src/zephyr/boards/arm/dtqsys_ht/dtqsys_defconfig
```kconfig
# SPDX-License-Identifier: Apache-2.0

CONFIG_SOC_SERIES_NRF52X=y
CONFIG_SOC_NRF52840_QIAA=y

# Enable MPU
CONFIG_ARM_MPU=y
CONFIG_HW_STACK_PROTECTION=y

# enable peripherals
CONFIG_GPIO=y

# enable flashing and linker options
CONFIG_USE_DT_CODE_PARTITION=y
```

## firmware/src/zephyr/boards/arm/dtqsys_ht/dtqsys_ht_defconfig
```kconfig
# SPDX-License-Identifier: Apache-2.0

# Enable MPU
CONFIG_ARM_MPU=y
CONFIG_HW_STACK_PROTECTION=y

# enable peripherals
CONFIG_GPIO=y
CONFIG_SERIAL=y

CONFIG_BOOTLOADER_BOSSA=y
CONFIG_BOOTLOADER_BOSSA_LEGACY=y

CONFIG_CLOCK_CONTROL_NRF=y
CONFIG_CLOCK_CONTROL_NRF_K32SRC_RC=y

CONFIG_LED_STRIP=y
CONFIG_SPI=y
```

## firmware/src/zephyr/boards/arm/licardo_ht/Kconfig.licardo_ht
```kconfig
# Copyright (c) 2020 Jefferson Lee.
# SPDX-License-Identifier: Apache-2.0

config BOARD_LICARDO_HT
	select SOC_NRF52840_QIAA
```

## firmware/src/zephyr/boards/arm/xiao__sense/Kconfig.board
```kconfig
# XIAO BLE board configuration

# Copyright (c) 2022 Marcin Niestroj
# SPDX-License-Identifier: Apache-2.0

config BOARD_XIAO_BLE
	bool "XIAO BLE"
	depends on SOC_NRF52840_QIAA

# Keep for compatibility with arduino nano 33 ble.. for now
config BOARD_ARDUINO_NANO_33_BLE_EN_USB_CONSOLE
	bool "Sends the console output over the USB port"
	depends on BOARD_XIAO_BLE

config BOARD_ARDUINO_NANO_33_BLE_INIT_SENSORS
	bool "Initializes the internal I2C sensors on the board"
	depends on BOARD_XIAO_BLE
```

## firmware/src/zephyr/boards/arm/xiao_sense/Kconfig.board
```kconfig
# XIAO BLE board configuration

# Copyright (c) 2022 Marcin Niestroj
# SPDX-License-Identifier: Apache-2.0

config BOARD_XIAO_SENSE
	bool "XIAO SENSE"
	depends on SOC_NRF52840_QIAA

config BOARD_XIAO_SENSE_INIT
	bool "Initializes the internal I2C sensors on the board"
	depends on BOARD_XIAO_SENSE
```

## firmware/src/zephyr/boards/arm/xiao_sense/Kconfig.defconfig
```kconfig
# XIAO BLE board configuration

# Copyright (c) 2022 Marcin Niestroj
# SPDX-License-Identifier: Apache-2.0

if BOARD_XIAO_SENSE

config BOARD
	default "xiao_sense"

config BT_CTLR
	default BT

endif # BOARD_XIAO_SENSE

if USB_DEVICE_STACK

config UART_CONSOLE
	default CONSOLE

endif # USB_DEVICE_STACK
```

## firmware/src/zephyr/boards/arm/xiao_sense/xiao_sense_defconfig
```kconfig
# SPDX-License-Identifier: Apache-2.0

CONFIG_SOC_SERIES_NRF52X=y
CONFIG_SOC_NRF52840_QIAA=y
CONFIG_BOARD_XIAO_SENSE=y

# Enable MPU
CONFIG_ARM_MPU=y
CONFIG_HW_STACK_PROTECTION=y

# enable GPIO
CONFIG_GPIO=y

# enable uart driver
CONFIG_SERIAL=y

# enable USB
CONFIG_USB_DEVICE_STACK=y

# Build UF2 by default, supported by the Adafruit nRF52 Bootloader
#  This does not seem to work in platformio. Using a python script
#  and uf2conv to do it after the .bin file is created
#CONFIG_BUILD_OUTPUT_UF2=y


CONFIG_USE_DT_CODE_PARTITION=y

# additional board options
CONFIG_GPIO_AS_PINRESET=y

CONFIG_BOARD_XIAO_SENSE_INIT=y
```
